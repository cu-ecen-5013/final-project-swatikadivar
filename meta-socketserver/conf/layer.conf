## meta-socketserver/conf/layer.conf
```bitbake
# We have a conf and classes directory, add to BBPATH 
BBPATH := "${BBPATH}:${LAYERDIR}" 

# We have a packages directory, add to BBFILES 
BBFILES := "${BBFILES} ${LAYERDIR}/recipes-*/*/*.bb \ 
            ${LAYERDIR}/recipes-*/*/*.bbappend" 

LAYERSERIES_COMPAT_meta-socketserver = "dunfell"

BBFILE_COLLECTIONS += "meta-socketserver" 
BBFILE_PATTERN_meta-socketserver:= "^${LAYERDIR}/" 
BBFILE_PRIORITY_meta-socketserver:= "6"

LAYERDEPENDS_socketserver= "core"
```

## poky_customized/build/conf/bblayers.conf
```bitbake
# POKY_BBLAYERS_CONF_VERSION is increased each time build/conf/bblayers.conf
# changes incompatibly
POKY_BBLAYERS_CONF_VERSION = "2"

BBPATH = "${TOPDIR}"
BBFILES ?= ""

BBLAYERS ?= " \
  /home/skadivar/swatikadivar-aesd-assignments/final-project-swatikadivar/poky/meta \
  /home/skadivar/swatikadivar-aesd-assignments/final-project-swatikadivar/poky/meta-poky \
  /home/skadivar/swatikadivar-aesd-assignments/final-project-swatikadivar/poky/meta-yocto-bsp \
  /home/skadivar/swatikadivar-aesd-assignments/final-project-swatikadivar/poky/meta-raspberrypi \
  /home/skadivar/swatikadivar-aesd-assignments/final-project-swatikadivar/poky/meta-openembedded/meta-oe \
  /home/skadivar/swatikadivar-aesd-assignments/final-project-swatikadivar/poky/meta-openembedded/meta-python \
  /home/skadivar/swatikadivar-aesd-assignments/final-project-swatikadivar/poky/meta-openembedded/meta-networking \
  "
```

## poky_customized/meta-openembedded/conf/layer.conf
```bitbake
# We have a conf and classes directory, add to BBPATH
BBPATH .= ":${LAYERDIR}"

# We have recipes-* directories, add to BBFILES
BBFILES += "${LAYERDIR}/recipes-*/*/*.bb \
            ${LAYERDIR}/recipes-*/*/*.bbappend"

BBFILE_COLLECTIONS += "meta-openembedded"
BBFILE_PATTERN_meta-openembedded = "^${LAYERDIR}/"
BBFILE_PRIORITY_meta-openembedded = "6"

LAYERDEPENDS_meta-openembedded = "core"
LAYERSERIES_COMPAT_meta-openembedded = "dunfell"
```
